## main/Kconfig.projbuild
```kconfig
menu "IOTA Wallet"

    menu "WiFi"
        config ESP_WIFI_SSID
            string "WiFi SSID"
            default "myssid"
            help
                SSID (network name) for the example to connect to.

        config ESP_WIFI_PASSWORD
            string "WiFi Password"
            default "mypassword"
            help
                WiFi password (WPA or WPA2) for the example to use.

        config ESP_MAXIMUM_RETRY
            int "Maximum retry"
            default 5
            help
                Set the Maximum retry to avoid station reconnecting to the AP unlimited when the AP is really inexistent.
    endmenu

    menu "SNTP"
        config SNTP_SERVER
            string "SNTP server"
            default "pool.ntp.org"
            help
                Endpoint of Network Time Protocol server.

        config SNTP_TZ
            string "Timezone"
            default "CST-8"
            help
                POSIX timezone. Ref: https://github.com/nayarsystems/posix_tz_db/blob/master/zones.json
    endmenu

    menu "Event Config"

        config EVENTS_HOST
            string "Events Node URL"
            default "192.168.11.111"
            help
                Iota events node url

        config EVENTS_PORT
            int "Events Port"
            default 1883
            help
                Iota events port

        config EVENTS_CLIENT_ID
            string "Events Client Id"
            default "iota_test_@123"
            help
                Client id for events

        config EVENTS_KEEP_ALIVE
            int "Events Keep Alive"
            default 60
            help
                Events connection keep alive time in seconds

        config EVENT_BLOCK_ID
            string "Block Id"
            default ""
            help
                Block id to querry metadata

        config EVENT_OUTPUT_ID
            string "Output Id"
            default ""
            help
                Output id to get output payload on state change

        config EVENT_TXN_ID
            string "Transaction Id"
            default ""
            help
                Transaction id to get confirmed message which carried the transaction with the specified transaction id

    endmenu

    config IOTA_NODE_URL
        string "IOTA Node URL"
        default "192.168.11.111"
        help
            The URL of an IOTA node.

    config IOTA_NODE_PORT
        int "port number"
        range 0 65535
        default 14265
        help
            The API port of the IOTA node.

    config IOTA_NODE_USE_TLS
        bool "IOTA node use tls"
        default n
        help
            The node tls.

    config WALLET_MNEMONIC
        string "Mnemonic"
        default "random"
        help
            The mnemonic sentence of this wallet

    config ENG_MNEMONIC_ONLY
        bool "English Mnemonic Only"
        default y
        help
            Support English mnemonic only

    config SENSOR_DELAY_SCALE
        int "Sensor Sampling Period"
        default 60
        help
            The scale of sampling period

    config IOTA_UNIT_TESTS
        bool "Testing Application"
        default n
        help
            Build unit tests application

endmenu
```

## sdkconfig.defaults
```kconfig
CONFIG_ESP_MAIN_TASK_STACK_SIZE=20480
CONFIG_ESP_TASK_WDT=n

# TLS validation
CONFIG_ESP_TLS_INSECURE=y
CONFIG_ESP_TLS_SKIP_SERVER_CERT_VERIFY=y

# esp32c3 compatibility
CONFIG_ESP32C3_REV_MIN_2=y
CONFIG_ESP32C3_REV_MIN=2

# partition table
CONFIG_PARTITION_TABLE_CUSTOM=y
CONFIG_PARTITION_TABLE_CUSTOM_FILENAME="partitions.csv"
```
